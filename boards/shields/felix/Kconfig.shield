## boards/shields/felix/Kconfig.shield
```kconfig
# Copyright (c) 2020 The ZMK Contributors
# SPDX-License-Identifier: MIT

config SHIELD_FELIX_LEFT
    def_bool $(shields_list_contains,felix_left)

config SHIELD_FELIX_RIGHT
    def_bool $(shields_list_contains,felix_right)
```
